## cmake/toolchain/llvm/Kconfig
```kconfig
config TOOLCHAIN_LLVM
	bool
	default y
	select NO_KERNEL_WEAK_MAIN

# TODO: armclang will add the symbol 'use_no_argv' to the object file
# when it finds an implementation of 'main' that does not have any
# arguments. It does this so that 'armlink' can choose libraries that
# don't support parsing of argv. So far so good.
#
# The problem is that when there exists both a weak and non-weak
# implementation of main you will get a multiple definition error on
# two symbols called 'use_no_argv'.
#
# Compiler bug? Workaround this by removing this definition of main.
```

## lib/low_level_c_runtime_library/Kconfig
```kconfig
config C_RUNTIME_SEGGER
	bool "Use the C runtime library from SEGGER"
	depends on CPU_CORTEX_M
	depends on ! NEWLIB_LIBC
	depends on EXTERNAL_LIBC
	help
	  Use the C runtime library provided by SEGGER. This library has a
	  different license from GCC and has different code size and
	  runtime characteristics.
```

## subsys/storage/stream/Kconfig
```kconfig
#
# Copyright (c) 2020 Nordic Semiconductor ASA
#
# SPDX-License-Identifier: Apache-2.0
#

config STORAGE_STREAM
        bool

menuconfig STREAM_FLASH
	bool "Support storage streams to flash"
	select FLASH_PAGE_LAYOUT
        select STORAGE_STREAM
	help
	  Enable support of stream writes to flash

if STREAM_FLASH
config STREAM_FLASH_ERASE
	bool "Perform erase operations"
	help
	  If disabled an external actor must erase the flash area being written
	  to.

module = STREAM_FLASH
module-str = stream flash
source "subsys/logging/Kconfig.template.log_config"

endif # STREAM_FLASH
```

## subsys/storage/stream/Kconfig.orig
```kconfig
#
# Copyright (c) 2020 Nordic Semiconductor ASA
#
# SPDX-License-Identifier: Apache-2.0
#

menuconfig FLASH_STREAM_WRITE
	bool "Flash stream Write"
	select FLASH_PAGE_LAYOUT
	help
	  Enable support of flash stream writes

if FLASH_STREAM_WRITE
config FSW_ERASE
	bool "Perform erase operations"
	help
	  If disabled an external actor must erase the flash area being written
	  to prior to invoking 'fsw_write'.

module = FSW
module-str = flash stream write
source "subsys/logging/Kconfig.template.log_config"

endif # FLASH_STREAM_WRITE
```
